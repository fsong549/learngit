/* Copyright (c) 2014, The Linux Foundation. All rights reserved.
*
* This program is free software; you can redistribute it and/or modify
* it under the terms of the GNU General Public License version 2 and
* only version 2 as published by the Free Software Foundation.
*
* This program is distributed in the hope that it will be useful,
* but WITHOUT ANY WARRANTY; without even the implied warranty of
* MERCHANTABILITY or FITNESS FOR A PARTICULAR PURPOSE.  See the
* GNU General Public License for more details.
*/
//add for fingerprint  
&soc {
    // add for fingerprint
	fingerprint_gpio {
		compatible = "qcom,fingerprint-gpio";
		interrupt-parent = <&msm_gpio>;
		fp-gpio-reset = <&msm_gpio 135 0x00>;
		fp-gpio-int = <&msm_gpio  106 0x00>;
		fp-gpio-power = <&msm_gpio  69 0x00>;
		status = "okay";
	};
};
//end for fingerprint
